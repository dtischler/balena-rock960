## layers/meta-nanopc-t4/conf/machine/rock960.conf
```bitbake
#@TYPE: Machine
#@NAME: 96Boards Rock960
#@SOC: Rockchip RK3399
#@DESCRIPTION: Machine configuration for 96Boards Rock960

require conf/machine/include/arm/arch-armv8.inc
require conf/machine/include/soc-family.inc

PREFERRED_PROVIDER_virtual/bootloader = "u-boot-rockchip"
PREFERRED_PROVIDER_virtual/kernel = "linux-rockchip"
PREFERRED_VERSION_linux-rockchip = "4.4.179%"

UBOOT_MACHINE = "rock960-rk3399_defconfig"

KERNEL_IMAGETYPE = "Image"

SERIAL_CONSOLES = "1500000;ttyS2"

KBUILD_DEFCONFIG = "rockchip_linux_defconfig"

KERNEL_DEVICETREE = "rockchip/rk3399-rock960-ab.dtb"

MACHINE_ESSENTIAL_EXTRA_RDEPENDS += "kernel-devicetree rkbin-wifi"
```
